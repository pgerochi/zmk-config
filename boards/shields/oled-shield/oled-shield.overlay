&i2c1 {
    status = "okay";
    ssd1306@3c {
        compatible = "solomon,ssd1306fb";
        reg = <0x3c>;
        label = "SSD1306";
        width = <128>;
        height = <32>; // change to <64> if 64px tall
        segment-offset = <0>;
        page-offset = <0>;
    };
};